## meta-ti-bsp/conf/machine/am62lxx-evm.conf
```bitbake
#@TYPE: Machine
#@NAME: AM62L EVM
#@DESCRIPTION: Machine configuration for the TI AM62L EVM

require conf/machine/include/am62lxx.inc

IMAGE_FSTYPES += "ubifs ubi"

MKUBIFS_ARGS ?= "-F -m 4096 -e 258048 -c 12000"

UBINIZE_ARGS ?= "-m 4096 -p 256KiB -s 1024 -O 1024"

KERNEL_DEVICETREE_PREFIX = " \
    ti/k3-am62l \
"

KERNEL_DEVICETREE = ""

UBOOT_MACHINE = ""

UBOOT_ECDSA_SIGN_CONFIG ?= "ecdsa"
UBOOT_ECDSA_SIGN_CONFIG:bsp-ti-6_6 = ""
UBOOT_ECDSA_SIGN_CONFIG:bsp-next = ""
UBOOT_ECDSA_SIGN_CONFIG:bsp-mainline = ""

UBOOT_CONFIG = "${UBOOT_ECDSA_SIGN_CONFIG} main"

UBOOT_CONFIG[main] = "am62lx_evm_defconfig"
UBOOT_CONFIG[ecdsa] = "am62lx_evm_defconfig"

UBOOT_CONFIG_MAKE_OPTS[ecdsa] = "${TI_SIGN_WITH_ECDSA_KEY}"

FIT_CONF_DEFAULT_DTB = "ti/k3-am62l3-evm.dtb"
UBOOT_LOADADDRESS = "0x82400000"
UBOOT_ENTRYPOINT = "0x82400000"
UBOOT_RD_LOADADDRESS = "0x84000000"
UBOOT_RD_ENTRYPOINT = "0x84000000"
UBOOT_DTB_LOADADDRESS = "0x84f00000"
UBOOT_DTBO_LOADADDRESS = "0x84f80000"

TFA_BOARD = "am62lx-evm"
```

## meta-ti-bsp/conf/machine/am68-sk.conf
```bitbake
#@TYPE: Machine
#@NAME: AM68 SK
#@DESCRIPTION: Machine configuration for the TI AM68 SK

require conf/machine/include/am68.inc

TFA_K3_USART = "0x8"
OPTEE_K3_USART = "0x8"

KERNEL_DEVICETREE_PREFIX = " \
    ti/k3-am68-sk \
    ti/k3-fpdlink \
    ti/k3-v3link \
    ti/k3-j721e-sk-csi2-dual-imx219 \
    ti/k3-j721e-sk-fpdlink-fusion \
"

KERNEL_DEVICETREE = " \
    ti/k3-am68-sk-base-board.dtb \
    ti/k3-j721e-sk-csi2-dual-imx219.dtbo \
"

UBOOT_MACHINE = "am68_sk_a72_defconfig"
UBOOT_MACHINE:tie-test-builds = ""

UBOOT_CONFIG = ""
UBOOT_CONFIG:tie-test-builds = "main"
UBOOT_CONFIG:prepend:tie-test-builds = "ethboot "

UBOOT_CONFIG[main] = "am68_sk_a72_defconfig"
UBOOT_CONFIG[ethboot] = "am68_sk_a72_ethboot_defconfig"
```

## meta-ti-bsp/conf/machine/am69-sk.conf
```bitbake
#@TYPE: Machine
#@NAME: AM69 SK
#@DESCRIPTION: Machine configuration for the TI AM69 SK

require conf/machine/include/am69.inc

TFA_K3_USART = "0x8"
OPTEE_K3_USART = "0x8"

KERNEL_DEVICETREE_PREFIX = " \
    ti/k3-am69-sk \
    ti/k3-fpdlink \
    ti/k3-v3link \
    ti/k3-am68-sk-v3link-fusion \
    ti/k3-j721e-sk-csi2-dual-imx219 \
    ti/k3-j721e-sk-fpdlink-fusion \
"

KERNEL_DEVICETREE = " \
    ti/k3-am69-sk.dtb \
    ti/k3-j721e-sk-csi2-dual-imx219.dtbo \
"

UBOOT_MACHINE = "am69_sk_a72_defconfig"
UBOOT_MACHINE:tie-test-builds = ""

UBOOT_CONFIG = ""
UBOOT_CONFIG:tie-test-builds = "main"
UBOOT_CONFIG:prepend:tie-test-builds = "ethboot "

UBOOT_CONFIG[main] = "am69_sk_a72_defconfig"
UBOOT_CONFIG[ethboot] = "am69_sk_a72_ethboot_defconfig"

MACHINE_ESSENTIAL_EXTRA_RRECOMMENDS += "ti-eth-fw-j784s4"
```

## meta-ti-bsp/conf/machine/j722s-evm.conf
```bitbake
#@TYPE: Machine
#@NAME: J722S EVM
#@DESCRIPTION: Machine configuration for the TI J722S EVM

require conf/machine/include/j722s.inc

KERNEL_DEVICETREE_PREFIX = " \
    ti/k3-j722s \
    ti/k3-fpdlink \
    ti/k3-am62x-sk-mcspi-loopback \
    ti/k3-v3link \
"

KERNEL_DEVICETREE = " \
    ti/k3-j722s-evm.dtb \
"

UBOOT_MACHINE = "j722s_evm_a53_defconfig"
UBOOT_MACHINE:tie-test-builds = ""

UBOOT_CONFIG = ""
UBOOT_CONFIG:tie-test-builds = "main"
UBOOT_CONFIG:prepend:tie-test-builds = "ethboot "

UBOOT_CONFIG[main] = "j722s_evm_a53_defconfig"
UBOOT_CONFIG[ethboot] = "j722s_evm_a53_ethboot_defconfig"
```
